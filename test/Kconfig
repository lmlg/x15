## test/Kconfig
```kconfig
menu "Test options"

config TEST_ATOMIC
	bool "atomic ops"
	default n
	select SYMTAB

config TEST_BULLETIN
	bool "bulletin API"
	default n
	select SYMTAB

config TEST_CAPABILITY
	bool "capability API"
	default n
	select SYMTAB

config TEST_FMT
	bool "formatted I/O"
	default n
	select SYMTAB

config TEST_FUTEX
	bool "futex API"
	default n
	select SYMTAB

config TEST_INTR
	bool "interrupt API"
	default n
	select SYMTAB

config TEST_IPC
	bool "inter-process communication"
	default n
	select SYMTAB

config TEST_MUTEX
	bool "mutex API"
	default n
	select SYMTAB

config TEST_MUTEX_PI
	bool "rtmutex API"
	default n
	select SYMTAB

config TEST_PERFMON_CPU
	bool "CPU performance counters"
	default n
	select SYMTAB

config TEST_PERFMON_THREAD
	bool "thread performance counters"
	default n
	select SYMTAB

config TEST_PERFMON_TORTURE
	bool "stress performance counters"
	default n
	select SYMTAB

config TEST_PMAP_UPDATE
	bool "pmap update"
	default n
	select SYMTAB

config TEST_RCU_DEFER
	bool "rcu defer"
	default n
	select SYMTAB

config TEST_RDXTREE
	bool "radix tree API"
	default n
	select SYMTAB

config TEST_SEMAPHORE
	bool "semaphore"
	default n
	select SYMTAB

config TEST_SLEEPQ_BROADCAST
	bool "sleepq broadcast"
	default n
	select SYMTAB

config TEST_SREF_DIRTY_ZEROES
	bool "sref dirty zeroes"
	default n
	select SYMTAB

config TEST_SREF_NOREF
	bool "sref no refs"
	default n
	select SYMTAB

config TEST_SREF_WEAKREF
	bool "sref weak references"
	default n
	select SYMTAB

config TEST_THREAD_AFFINITY
	bool "thread CPU affinity"
	default n
	select SYMTAB

config TEST_THREAD_SUSPEND
	bool "thread suspend/resume"
	default n
	select SYMTAB

config TEST_UNWIND
	bool "unwind API"
	default n
	select SYMTAB

config TEST_VM_PAGE_FILL
	bool "vm page filling"
	default n
	select SYMTAB

config TEST_VM_FAULT
	bool "vm page fault"
	default n
	select SYMTAB

config TEST_XCALL
	bool "xcall"
	default n
	select SYMTAB

endmenu
```
